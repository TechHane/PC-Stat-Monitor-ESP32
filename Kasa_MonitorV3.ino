#include <TFT_eSPI.h>
#include <SPI.h>

TFT_eSPI tft = TFT_eSPI();

// =====================================================
// GPU LOGO - 48x48 - image2cpp uyumlu horizontal 1-bit
// Senin attığın görselden hazırlandı
// =====================================================
const unsigned char epd_bitmap_gpu_logo[] PROGMEM = {
  0x00, 0x00, 0x00, 0x00, 0x00, 0x00, 0x00, 0x00, 0x00, 0x00, 0x00, 0x00, 0x00, 0x00, 0x00, 0x00, 
	0x00, 0x00, 0x00, 0x00, 0x00, 0x00, 0x00, 0x00, 0x00, 0x00, 0x00, 0x00, 0x00, 0x00, 0x00, 0x00, 
	0x00, 0x00, 0x00, 0x00, 0x00, 0x00, 0x00, 0x00, 0x00, 0x00, 0x00, 0x00, 0x00, 0x00, 0x00, 0x00, 
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	0x00, 0x00, 0x00, 0x00, 0x00, 0x00, 0x00, 0x00, 0x00, 0x00, 0x00, 0x00, 0x00, 0x00, 0x00, 0x00,
  // EKLENEN 2 BOŞ SATIR (12 byte)
  0x00, 0x00, 0x00, 0x00, 0x00, 0x00,
  0x00, 0x00, 0x00, 0x00, 0x00, 0x00
};
const unsigned char epd_bitmap_cpu_logo[] PROGMEM = {
  0x00, 0x18, 0x18, 0x18, 0x18, 0x00, 0x00, 0x18, 0x18, 0x18, 0x18, 0x00,
  0x00, 0x18, 0x18, 0x18, 0x18, 0x00, 0x00, 0x18, 0x18, 0x18, 0x18, 0x00,
  0x00, 0x00, 0x00, 0x00, 0x00, 0x00, 0x03, 0xFF, 0xFF, 0xFF, 0xFF, 0xC0,
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  0x00, 0x18, 0x18, 0x18, 0x18, 0x00, 0x00, 0x18, 0x18, 0x18, 0x18, 0x00,

  // EKLENEN 2 BOŞ SATIR (12 byte)
  0x00, 0x00, 0x00, 0x00, 0x00, 0x00,
  0x00, 0x00, 0x00, 0x00, 0x00, 0x00
};

String cpuT, cpuL, cpuF, gpuT, gpuL, gpuF, vram, fan, pwr, ram, netD, netU,deneme;

// =====================================================
// image2cpp Horizontal - 1 bit per pixel için doğru çizim
// =====================================================
void drawManualBitmap(int x, int y, const unsigned char* bitmap, int w, int h, uint16_t color) {
  int byteWidth = (w + 7) / 8;

  tft.startWrite();
  for (int j = 0; j < h; j++) {
    for (int i = 0; i < w; i++) {
      uint8_t b = pgm_read_byte(bitmap + j * byteWidth + i / 8);
      if (b & (0x80 >> (i & 7))) {
        tft.drawPixel(x + i, y + j, color);
      }
    }
  }
  tft.endWrite();
}

void setup() {
  Serial.begin(115200);
  tft.init();
  tft.setRotation(0);
  tft.fillScreen(TFT_BLACK);
  drawUI();
}

void loop() {
  if (Serial.available() > 0) {
    String data = Serial.readStringUntil('*');
    parseData(data);
    updateScreen();
  }
}

void parseData(String data) {
  int indices[12];
  int count = 0;

  for (int i = 0; i < data.length(); i++) {
    if (data[i] == ',' && count < 12) {
      indices[count++] = i;
    }
  }

  if (count < 12) return;

  cpuT = data.substring(0, indices[0]);
  cpuL = data.substring(indices[0] + 1, indices[1]);
  cpuF = data.substring(indices[1] + 1, indices[2]);
  gpuT = data.substring(indices[2] + 1, indices[3]);
  gpuL = data.substring(indices[3] + 1, indices[4]);
  gpuF = data.substring(indices[4] + 1, indices[5]);
  vram = data.substring(indices[5] + 1, indices[6]);
  fan  = data.substring(indices[6] + 1, indices[7]);
  pwr  = data.substring(indices[7] + 1, indices[8]);
  ram  = data.substring(indices[8] + 1, indices[9]);
  netD = data.substring(indices[9] + 1, indices[10]);
  netU = data.substring(indices[10] +1 , indices[11]);
  deneme =data.substring(indices[11] + 1);
}
void drawBar(int x, int y, int w, int h, float percent, uint16_t color) {
  // Dış çerçeve
  tft.drawRect(x, y, w, h, TFT_WHITE);
  
  // İçerideki doluluk miktarı (yüzdeye göre hesaplanır)
  int fillWidth = (w - 4) * (percent / 100.0);
  if (fillWidth < 0) fillWidth = 0;
  if (fillWidth > (w - 4)) fillWidth = w - 4;

  // Önce içini temizle (Eski barın kalıntısı kalmasın diye)
  tft.fillRect(x + 2, y + 2, w - 4, h - 4, TFT_BLACK);
  
  // Yeni barı çiz
  tft.fillRect(x + 2, y + 2, fillWidth, h - 4, color);
}

void drawUI() {
  tft.fillScreen(TFT_BLACK);

  // Çerçeveler
  tft.drawRoundRect(1, 5, 237, 95, 5, TFT_RED);
  tft.drawRoundRect(1, 105, 237, 115, 5, TFT_GREEN);
  tft.drawRoundRect(1, 225, 237, 90, 5, TFT_BLUE);

  // Logolar için arka plan temizle
  tft.fillRect(10, 30, 48, 48, TFT_BLACK);
  tft.fillRect(10, 130, 62, 62, TFT_BLACK);

  // CPU logo
 // drawManualBitmap(10, 40, epd_bitmap_cpu_logo, 48, 48, TFT_RED);

  // GPU logo
 // drawManualBitmap(10, 130, epd_bitmap_gpu_logo, 62, 62, TFT_GREEN);

  // Başlıklar
  tft.setTextSize(1);
  tft.setTextColor(TFT_LIGHTGREY, TFT_BLACK);
  tft.setTextDatum(TL_DATUM);

  tft.drawString("AMD Ryzen 7", 10, 10);
  tft.drawString("9700X", 10, 20);
  tft.drawString("TEMP", 95, 12); tft.drawString("LOAD %", 185, 12);
  tft.drawString("GeForce", 10, 110);
  tft.drawString("RTX 5070", 10, 120);
  tft.drawString("TEMP", 95, 112); tft.drawString("LOAD %", 185, 112);
  tft.drawString("RAM MEMORY / 32GB", 10, 230);
  tft.drawString("NETWORK (Wi-Fi)", 130, 230);
}
/*void clearValueAreas() {
 tft.fillRect(120, 170, 150, 20, TFT_BLACK);  // GPU frekans
}*/
void updateScreen() {
  float currentCpuTemp = cpuT.toFloat(); // String olan sıcaklığı sayıya çeviriyoruz

  // CPU RENK DEGİSİMLERİ
  if (currentCpuTemp >= 75.0) {
    tft.setTextColor(TFT_RED, TFT_BLACK);     // 80 derece ve üstü KIRMIZI
    drawManualBitmap(10, 40, epd_bitmap_cpu_logo, 48, 48, TFT_RED);
  } 
  else if (currentCpuTemp >= 50.0) {
    tft.setTextColor(TFT_ORANGE, TFT_BLACK);  // 65-79 derece arası TURUNCU
    drawManualBitmap(10, 40, epd_bitmap_cpu_logo, 48, 48, TFT_ORANGE);
  } 
  else {
    tft.setTextColor(TFT_WHITE, TFT_BLACK);   // 65 altı normal BEYAZ
    drawManualBitmap(10, 40, epd_bitmap_cpu_logo, 48, 48, TFT_GREEN);
  }
  tft.setTextDatum(TR_DATUM); 
  tft.setTextSize(3);
  tft.drawString(cpuT + " ", 180, 35); // Bir boşluk eklemek karakter kısalınca kalıntıyı siler

// GPU RENK DEGİSİMLERİ
  float currentgpuTemp = gpuT.toFloat(); // String olan sıcaklığı sayıya çeviriyoruz
  if (currentgpuTemp >= 75.0) {
    tft.setTextColor(TFT_RED, TFT_BLACK);     // 80 derece ve üstü KIRMIZI
    drawManualBitmap(10, 130, epd_bitmap_gpu_logo, 62, 62, TFT_RED);
  } 
  else if (currentgpuTemp >= 50.0) {
    tft.setTextColor(TFT_ORANGE, TFT_BLACK);  // 65-79 derece arası TURUNCU
    drawManualBitmap(10, 130, epd_bitmap_gpu_logo, 62, 62, TFT_ORANGE);
  } 
  else {
    tft.setTextColor(TFT_WHITE, TFT_BLACK);   // 65 altı normal BEYAZ
    drawManualBitmap(10, 130, epd_bitmap_gpu_logo, 62, 62, TFT_GREEN);
  }
  tft.setTextDatum(TR_DATUM); 
  tft.setTextSize(3);
  tft.drawString(gpuT + " ", 190, 135);

  //tft.setTextSize(3);
  //tft.setTextColor(TFT_WHITE, TFT_BLACK);
  
  // Sıcaklık ve Load değerleri için (Gelen string sonuna boşluk ekleyerek kalıntıyı eziyoruz)
  tft.setTextDatum(TR_DATUM); 
  //tft.drawString(cpuT + " ", 180, 35); // Bir boşluk eklemek karakter kısalınca kalıntıyı siler
  tft.setTextSize(2);
  tft.setTextColor(TFT_WHITE, TFT_BLACK);
  tft.drawString(cpuL, 230, 35);

 
  tft.setTextSize(2);
  tft.drawString(gpuL, 230, 135);

  // Frekanslar - Kalıntı yapan asıl yer
  tft.setTextSize(2);
  tft.setTextDatum(TL_DATUM);
  
  // CPU Frekans: "4500" yazıp yanına sabit " MHz" ekliyoruz. 
  // Eski değerden kalanları temizlemek için sonuna 2-3 boşluk bırakıyoruz.
  tft.setTextColor(TFT_GREEN, TFT_BLACK);
  tft.drawString(cpuF +" MHz", 70, 65); 

  // GPU Frekans
  tft.setTextColor(TFT_GREEN, TFT_BLACK);
  tft.drawString(gpuF + " MHz   ", 80, 170); 

  // Alt GPU bilgiler (Kalıntı kalmaması için sonlarına boşluk)
  tft.setTextSize(1);
  tft.setTextColor(TFT_WHITE, TFT_BLACK);
  tft.drawString("VRAM: " + vram + " MB / 12GB   ", 80, 195);
  tft.drawString("RPM:" + fan + "  ", 170, 205);
  tft.drawString("PWR:" + pwr + "W   ", 80, 205);
  // CPU FAN YÜZDE
  tft.drawString("FAN: " + deneme + " %   ", 70, 85);
  // RAM 
  tft.setTextSize(2);
  tft.setTextColor(TFT_YELLOW, TFT_BLACK);
  tft.drawString(ram + "GB   ", 15, 260);
  
  // Network
  tft.setTextSize(2);
  tft.setTextColor(TFT_GREEN, TFT_BLACK);
  //tft.drawString("D:" + netD + " Kb/s   ", 140, 255);
  tft.drawString("D:" + netD + " ", 130, 255);
  tft.setTextSize(1);
  tft.drawString("Kb/s",205, 255);

  tft.setTextSize(2);
  tft.setTextColor(TFT_PURPLE, TFT_BLACK);
  //tft.drawString("U:" + netU + " Kb/s   ", 140, 275);
  tft.drawString("U:" + netU + " ", 130, 275);
  tft.setTextSize(1);
  tft.drawString("Kb/s",205, 275);

  // Kanal Reklamı
  tft.setTextColor(TFT_CYAN, TFT_BLACK);
  tft.setTextSize(2);
  tft.drawString("TechHane",70, 305);

  // GPU VRAM Barı Hazırlığı
  // vram değerini float'a çevirip 12GB'a oranlıyoruz
  float vramGB = vram.toFloat();
  float vramPercent = (vramGB / 12000) * 100.0;
  if (vramPercent > 100.0) vramPercent = 100.0; // Taşırma yapmasın

  // Barı çizdirelim (Koordinatlar: X=75, Y=215, Genişlik=150, Yükseklik=10)
  drawBar(15, 195, 50, 15, vramPercent, TFT_GREEN);

  //RAM Barı Hazırlığı
  //ram değerini float'a çevirip 32GB'a oranlıyoruz
  float ramGB = ram.toFloat();
  float ramPercent = (ramGB / 32) * 100.0;
  if (ramPercent > 100.0) ramPercent = 100.0; // Taşırma yapmasın

  // Barı çizdirelim (Koordinatlar: X=75, Y=215, Genişlik=150, Yükseklik=10)
  drawBar(15, 285, 80, 15, ramPercent, TFT_YELLOW);

}